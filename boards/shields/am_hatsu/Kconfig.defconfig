## boards/shields/am_hatsu/Kconfig.defconfig
```kconfig
if SHIELD_AM_HATSU_LEFT

config ZMK_KEYBOARD_NAME
	default "Am-Hatsu"

config ZMK_SPLIT_BLE_ROLE_CENTRAL
	default y

endif

if SHIELD_AM_HATSU_LEFT || SHIELD_AM_HATSU_RIGHT

config ZMK_SPLIT
	default y

endif
```
